#include <Arduino.h>
#include <U8g2lib.h>
#include <U8x8lib.h>
#include <ESP8266WiFi.h>
#include <ESP8266WebServer.h>    
#include <ESP8266HTTPClient.h>
#include <WiFiClientSecureBearSSL.h>

#ifndef AUTOCONNECT_MENU_TITLE
#define AUTOCONNECT_MENU_TITLE  "NGPEW Sensor Config"
#endif
#include <AutoConnect.h>
#include <TaskManagerIO.h>



ESP8266WebServer Server;
AutoConnect  portal;
AutoConnectConfig config;
WiFiClient   wifiClient;
HTTPClient http;

U8G2_SSD1306_128X32_UNIVISION_F_HW_I2C u8g2(U8G2_R0, /* reset=*/ 16, /* clock=*/ 5, /* data=*/ 4);
const int LeftPin = 0; 
const int RightPin = 15; 
const int SelectPin = 13; 


#define GET_CHIPID()  (ESP.getChipId())
typedef ESP8266WebServer  WiFiWebServer;

#include <FS.h>
#if defined(ARDUINO_ARCH_ESP8266)
#ifdef AUTOCONNECT_USE_SPIFFS
FS& FlashFS = SPIFFS;
#else
#include <LittleFS.h>
FS& FlashFS = LittleFS;
#endif
#elif defined(ARDUINO_ARCH_ESP32)
#include <SPIFFS.h>
fs::SPIFFSFS& FlashFS = SPIFFS;
#endif

String  serverName;
String  channelId;
String  userKey;
String  apiKey;
String  apid;
String  hostName;
bool  uniqueid;

unsigned int  updateInterval = 0;
unsigned long lastPub = 0;
#define MQTT_USER_ID  "ngpew"
#define PARAM_FILE      "/param.json"
#define AUX_SETTING_URI "/mqtt_setting"
#define AUX_SAVE_URI    "/mqtt_save"
#define AUX_CLEAR_URI   "/mqtt_clear"

static const char AUX_mqtt_setting[] PROGMEM = R"raw(
[
  {
    "title": "NGPEW Settings",
    "uri": "/mqtt_setting",
    "menu": true,
    "element": [
      {
        "name": "style",
        "type": "ACStyle",
        "value": "label+input,label+select{position:sticky;left:120px;width:230px!important;box-sizing:border-box;}"
      },
      {
        "name": "header",
        "type": "ACText",
        "value": "<h2>NGPEW broker settings</h2>",
        "style": "text-align:center;color:#2f4f4f;padding:10px;"
      },
      {
        "name": "mqttserver",
        "type": "ACInput",
        "value": "",
        "label": "Server:Port",
        "placeholder": "NGPEW Broker Server"
      },
      {
        "name": "channelid",
        "type": "ACInput",
        "label": "Channel ID"
      },
      {
        "name": "userkey",
        "type": "ACInput",
        "label": "User Key"
      },
      {
        "name": "apikey",
        "type": "ACInput",
        "label": "API Key"
      },
      {
        "name": "newline",
        "type": "ACElement",
        "value": "<hr>"
      },
      {
        "name": "save",
        "type": "ACSubmit",
        "value": "Save&amp;Start",
        "uri": "/mqtt_save"
      },
      {
        "name": "discard",
        "type": "ACSubmit",
        "value": "Discard",
        "uri": "/"
      }
    ]
  },
  {
    "title": "NGPEW Settings",
    "uri": "/mqtt_save",
    "menu": false,
    "element": [
      {
        "name": "caption",
        "type": "ACText",
        "value": "<h4>Parameters saved as:</h4>",
        "style": "text-align:center;color:#2f4f4f;padding:10px;"
      },
      {
        "name": "parameters",
        "type": "ACText"
      },
      {
        "name": "clear",
        "type": "ACSubmit",
        "value": "Clear channel",
        "uri": "/mqtt_clear"
      }
    ]
  }
]
)raw";
// Easter Egg, Some sick tunes from DubMood! Hope you have a soundblaster!
const unsigned char PROGMEM SHrKanManOcksGra_7z[] = {
  0x37, 0x7a, 0xbc, 0xaf, 0x27, 0x1c, 0x00, 0x04, 0x54, 0xb2, 0xb2, 0x99,
  0x90, 0x2b, 0x00, 0x00, 0x00, 0x00, 0x00, 0x00, 0x72, 0x00, 0x00, 0x00,
  0x00, 0x00, 0x00, 0x00, 0xf4, 0x87, 0x71, 0x56, 0xe0, 0xc1, 0xdb, 0x2b,
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  0x20, 0x00, 0x00, 0x00, 0x00, 0x00
};
const unsigned int SHrKanManOcksGra_7z_len = 11298;

void getParams(AutoConnectAux& aux) {
  serverName = aux["mqttserver"].value;
  serverName.trim();
  channelId = aux["channelid"].value;
  channelId.trim();
  userKey = aux["userkey"].value;
  userKey.trim();
  apiKey = aux["apikey"].value;
  apiKey.trim();
}

// Load parameters saved with  saveParams from SPIFFS into the
// elements defined in /mqtt_setting JSON.
String loadParams(AutoConnectAux& aux, PageArgument& args) {
  (void)(args);
  File param = FlashFS.open(PARAM_FILE, "r");
  if (param) {
    if (aux.loadElement(param)) {
      getParams(aux);
      Serial.println(PARAM_FILE " loaded");
    }
    else
      Serial.println(PARAM_FILE " failed to load");
    param.close();
  }
  else
    Serial.println(PARAM_FILE " open failed");
  return String("");
}

String saveParams(AutoConnectAux& aux, PageArgument& args) {
  // The 'where()' function returns the AutoConnectAux that caused
  // the transition to this page.
  AutoConnectAux&   mqtt_setting = *portal.aux(portal.where());
  getParams(mqtt_setting);
  AutoConnectInput& mqttserver = mqtt_setting["mqttserver"].as<AutoConnectInput>();

  // The entered value is owned by AutoConnectAux of /mqtt_setting.
  // To retrieve the elements of /mqtt_setting, it is necessary to get
  // the AutoConnectAux object of /mqtt_setting.
  File param = FlashFS.open(PARAM_FILE, "w");
  mqtt_setting.saveElement(param, { "mqttserver", "channelid", "userkey", "apikey" });
  param.close();

  // Echo back saved parameters to AutoConnectAux page.
  AutoConnectText&  echo = aux["parameters"].as<AutoConnectText>();
  echo.value = "Server: " + serverName;
  echo.value += "<br>Channel ID: " + channelId + "<br>";
  echo.value += "User Key: " + userKey + "<br>";
  echo.value += "API Key: " + apiKey + "<br>";

  return String("");
}


void handleRoot() {
  String  content =
    "<html>"
    "<head>"
    "</head>"
    "<body>"
    "<iframe width=\"450\" height=\"260\" style=\"transform:scale(0.79);-o-transform:scale(0.79);-webkit-transform:scale(0.79);-moz-transform:scale(0.79);-ms-transform:scale(0.79);transform-origin:0 0;-o-transform-origin:0 0;-webkit-transform-origin:0 0;-moz-transform-origin:0 0;-ms-transform-origin:0 0;border: 1px solid #cccccc;\" src=\"https://{{SERVER}}/graph.php?id={{CHANNEL}}\"></iframe>"
    "<p style=\"padding-top:5px;text-align:center\">" AUTOCONNECT_LINK(COG_24) "</p>"
    "</body>"
    "</html>";
  content.replace("{{SERVER}}", serverName);
  content.replace("{{CHANNEL}}", channelId);
  WiFiWebServer&  webServer = portal.host();
  webServer.send(200, "text/html", content);
}

int ReadLeftButton = 0;
int ReadRightButton = 0;
int ReadSelectButton = 0;
int LightSensor = 0;
void PrntTaskDebug(){
  char slotData[32];
  Serial.print(F("Tasks: "));
  Serial.print(taskManager.checkAvailableSlots(slotData, sizeof slotData));
  Serial.print(F(" FMem: "));Serial.print(ESP.getFreeHeap());
  Serial.print(F(" Sense: "));Serial.print(LightSensor);Serial.print(ReadLeftButton);Serial.print(ReadRightButton);Serial.println(ReadSelectButton);
}

int menuidx = 0;
int fileidx = 0;
int randNumber;
void DisplayMenu(){
   if(ReadSelectButton == 0){ menuidx = 0; }else{
   if(ReadRightButton == 1){ menuidx = 3; }else{
   if(ReadLeftButton == 0){ menuidx = 2; }else{
    menuidx = 1;
   }}}
   switch (menuidx) {
      case 0:
          u8g2.clearBuffer();
          u8g2.setFont(u8g2_font_open_iconic_embedded_4x_t);
          u8g2.drawGlyph(1,32,80);
          u8g2.setFont(u8g2_font_crox2tb_tr);
          u8g2.setCursor(32,16);  
          u8g2.print(WiFi.RSSI()); 
          u8g2.setCursor(32,32);
          u8g2.setFont(u8g2_font_6x10_tf); 
          u8g2.print(WiFi.localIP()); 
          u8g2.sendBuffer();  
      break;
      case 1:
          u8g2.clearBuffer();
          u8g2.setFont(u8g2_font_open_iconic_embedded_4x_t);
          u8g2.drawGlyph(1,32,77);
          if(LightSensor < 45){
          u8g2.drawBox(32,7,LightSensor*2,25);
          }else{
            u8g2.drawGlyph(32,32,71);
            u8g2.drawGlyph(64,32,71);
          }
          u8g2.sendBuffer();      
      break;
      case 2:
          u8g2.clearBuffer();
          u8g2.setFont(u8g2_font_open_iconic_embedded_4x_t);
          u8g2.drawGlyph(1,32,67);
          u8g2.setFont(u8g2_font_crox2tb_tr);
          u8g2.setCursor(32,16);  
          u8g2.print("NGPEW"); 
          u8g2.setCursor(32,32);
          u8g2.setFont(u8g2_font_6x10_tf); 
          u8g2.print("Remote Sensor V1"); 
          u8g2.sendBuffer();     
      break;
      case 3:
          u8g2.clearBuffer();
          u8g2.setFont(u8g2_font_open_iconic_embedded_4x_t);
          u8g2.drawGlyph(1,32,72);
          u8g2.setFont(u8g2_font_crox2tb_tr);
          u8g2.setCursor(34,16);  
          u8g2.print("Status Code");
          u8g2.setCursor(34,32);
          u8g2.setFont(u8g2_font_crox2tb_tr);
          randNumber = random(10);
          if(randNumber > 8){
          if(fileidx >  SHrKanManOcksGra_7z_len ){fileidx = 0;}else{fileidx++;}
          }
          uint8_t byteval = pgm_read_byte(SHrKanManOcksGra_7z + fileidx);
          u8g2.print(byteval, HEX); 
          u8g2.sendBuffer();    
      break;
   }
   
}
void ReadSensor(){
   LightSensor = analogRead(A0);
   ReadLeftButton = digitalRead(LeftPin);
   ReadRightButton = digitalRead(RightPin);
   ReadSelectButton = digitalRead(SelectPin);
}


const uint8_t fingerprint[20] = {0x65, 0x84, 0xEC, 0xE7, 0x3D, 0x27, 0x35, 0x23, 0x6F, 0xC6, 0xC0, 0x35, 0xB9, 0xD7, 0xA2, 0x93, 0x37, 0x07, 0x6D, 0x6F};  //NGPEW Cert, Good for 10 years! Very Secure, Much Cert Pinning
std::unique_ptr<BearSSL::WiFiClientSecure>client(new BearSSL::WiFiClientSecure);
HTTPClient https;
void SendToBackEnd(){
   client->setFingerprint(fingerprint);
    client->setBufferSizes(512, 512);
    if (https.begin(*client, "https://" + serverName +"/post.php?id="+channelId+"&user="+userKey+"&key="+apiKey+"&name="+hostName+"&apid="+apid+"&value="+LightSensor)) {  // HTTPS

      // start connection and send HTTP header
      int httpCode = https.GET();

      // httpCode will be negative on error
      if (httpCode > 0) {
        // HTTP header has been send and Server response header has been handled
        // file found at server
        if (httpCode == HTTP_CODE_OK || httpCode == HTTP_CODE_MOVED_PERMANENTLY) {
        }
      } else {
        Serial.print(https.errorToString(httpCode).c_str());
      }
      https.end();
    } else {
    } 
}

void doPortal(){
  portal.handleClient();
}

static uint32_t current_raw_location,start_raw_location;
void handleClearChannel() {
FlashFS.format();
  EEPROM.begin(512);
  for (int i = 0 ; i < EEPROM.length() ; i++) {
    EEPROM.write(i, 0);
    yield();
    Serial.print(i);Serial.print(".");
  }
  EEPROM.end();
  FlashFS.format();
WiFi.disconnect(true);
delay(2000);
ESP.reset();
}

void setup() {
    u8g2.begin();
    u8g2.clearBuffer();
    u8g2.setFont( u8g2_font_6x10_tf);
    u8g2.drawStr(0,10, "Connect to Wifi AP:"); 
    u8g2.drawStr(10,19, "esp8266ap"); 
    u8g2.drawStr(0,30,"Pass: 12345678"); 
    u8g2.sendBuffer();     
    Serial.begin(115200);
    FlashFS.begin();
    pinMode(LeftPin, INPUT);  
    pinMode(RightPin, INPUT);  
    pinMode(SelectPin, INPUT_PULLUP);  
    Serial.print(ESP.getFreeHeap());Serial.print(F(" "));Serial.print(ESP.getHeapFragmentation());Serial.print(F(" "));Serial.println(ESP.getMaxFreeBlockSize());
    AutoConnectAux& mqtt_setting = *portal.aux(AUX_SETTING_URI);

    taskManager.scheduleFixedRate(30, SendToBackEnd, TIME_SECONDS);
    taskManager.scheduleFixedRate(250, DisplayMenu, TIME_MICROS);
    taskManager.scheduleFixedRate(100, ReadSensor, TIME_MICROS);
    taskManager.scheduleFixedRate(5, PrntTaskDebug, TIME_SECONDS);
    taskManager.scheduleFixedRate(10, doPortal, TIME_MICROS);
    

  // Reconnect and continue publishing even if WiFi is disconnected.
  config.autoReconnect = true;
  config.reconnectInterval = 1;
  Serial.print(ESP.getFreeHeap());Serial.print(F(" "));Serial.print(ESP.getHeapFragmentation());Serial.print(F(" "));Serial.println(ESP.getMaxFreeBlockSize());
  portal.config(config);
    if (portal.begin()) {
      WiFiWebServer&  webServer = portal.host();
      webServer.on("/", handleRoot);
      webServer.on(AUX_CLEAR_URI, handleClearChannel);
    }
    if (portal.load(FPSTR(AUX_mqtt_setting))) {
    PageArgument  args;
    loadParams(mqtt_setting, args);
    portal.on(AUX_SETTING_URI, loadParams);
    portal.on(AUX_SAVE_URI, saveParams);
  }
    Serial.println(F("==BOOT=="));
}

void loop() {
  taskManager.runLoop();
}
